## configs/shredos_defconfig
```kconfig
BR2_x86_64=y
BR2_GLOBAL_PATCH_DIR="board/shredos/patches"
BR2_TOOLCHAIN_BUILDROOT_GLIBC=y
BR2_GCC_VERSION_7_X=y
BR2_TOOLCHAIN_BUILDROOT_CXX=y
BR2_TARGET_GENERIC_HOSTNAME="shredos"
BR2_TARGET_GENERIC_ISSUE="shredos"
BR2_INIT_SYSV=y
BR2_ROOTFS_DEVICE_CREATION_DYNAMIC_EUDEV=y
# BR2_TARGET_GENERIC_REMOUNT_ROOTFS_RW is not set
BR2_ROOTFS_OVERLAY="board/shredos/fsoverlay"
BR2_ROOTFS_POST_IMAGE_SCRIPT="board/shredos/doimg.sh"
BR2_LINUX_KERNEL=y
BR2_LINUX_KERNEL_USE_CUSTOM_CONFIG=y
BR2_LINUX_KERNEL_CUSTOM_CONFIG_FILE="board/shredos/kernel-4.14-defconfig.config"
BR2_PACKAGE_BINUTILS=y
BR2_PACKAGE_KBD=y
BR2_PACKAGE_SMARTMONTOOLS=y
BR2_PACKAGE_TRIGGERHAPPY=y
BR2_PACKAGE_UTIL_LINUX_BINARIES=y
BR2_PACKAGE_UTIL_LINUX_MOUNT=y
BR2_PACKAGE_NWIPE=y
BR2_TARGET_ROOTFS_CPIO_LZMA=y
BR2_TARGET_ROOTFS_INITRAMFS=y
# BR2_TARGET_ROOTFS_TAR is not set
BR2_TARGET_GRUB2=y
BR2_PACKAGE_HOST_GENIMAGE=y
```

## package/nwipe/Config.in
```kconfig
config BR2_PACKAGE_NWIPE
        bool "nwipe"
	select BR2_PACKAGE_NCURSES
	select BR2_PACKAGE_PARTED
        help
          NWipe

comment "nwipe"
```
